## config/west.yml
```yaml
manifest:
  remotes:
    - name: zmkfirmware
      url-base: https://github.com/zmkfirmware
    - name: aaronkollasch
      url-base: https://github.com/aaronkollasch
  projects:
    - name: zmk
      remote: aaronkollasch
      revision: main
      import: app/west.yml
  self:
    path: config
```
